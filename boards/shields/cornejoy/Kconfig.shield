## boards/shields/cornejoy/Kconfig.shield
```kconfig
# Copyright (c) 2020 Pete Johanson
# SPDX-License-Identifier: MIT

config SHIELD_CORNEJOY_LEFT
    def_bool $(shields_list_contains,cornejoy_left)

config SHIELD_CORNEJOY_RIGHT
    def_bool $(shields_list_contains,cornejoy_right)
```

## config/west.yml
```yaml
manifest:
  remotes:
   - name: zmkfirmware
     url-base: https://github.com/zmkfirmware
   - name: felixm12138
     url-base: https://github.com/felixm12138
  projects:
   - name: zmk
     remote: zmkfirmware
     revision: main
     import: app/west.yml
   - name: zmk-analog-input-driver
     remote: felixm12138
     revision: main
  self:
    path: config
```
